## components/hy_update/Kconfig
```kconfig
menu "Hygeia firmware update"

    config HY_UPDATE_REPO
        string "GitHub repository the device updates from"
        default "giovi321/hygeia"
        help
            owner/name of the GitHub repository whose latest release the device checks and installs.
            A fork sets its own repository so its devices follow its own releases.

endmenu
```

## main/Kconfig.projbuild
```kconfig
menu "Hygeia"

    config HY_DEBUG_CONSOLE
        bool "Serial debug console"
        default y
        help
            Line commands on the USB console for development (time, tap, shot, ...).
            Release builds set this to n.

    config HY_PMU_CHARGER_SETUP
        bool "Set up the AXP2101 charger at boot"
        default y
        help
            At boot, turn off the TS-pin measurement and set the charge target to 4.2 V and the
            constant charge current to 150 mA (sized for a 320 mAh cell). n leaves the charger as found.

    config HY_PM_SCREEN_ON_DFS
        bool "Let the CPU scale down while the screen is on, on battery"
        default y
        depends on PM_ENABLE
        help
            On battery, release the hy_awake CPU-max lock while the screen is on. The CPU runs at
            240 MHz while any task runs (FreeRTOS rtos locks) and through each LVGL refresh
            (hy_render lock, from LV_EVENT_REFR_START to LV_EVENT_REFR_READY), and at 40 MHz in idle.
            The SPI flushes hold their own APB-max lock. On USB, hy_awake stays held as before.
            n holds hy_awake whenever the sleep mode is off, at the cost of about 10 to 20 mA
            (estimate) while the screen is on.

endmenu
```
